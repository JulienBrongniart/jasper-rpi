## buildroot_external/Config.in
```kconfig
source "$BR2_EXTERNAL/package/python-pyaudio/Config.in"
source "$BR2_EXTERNAL/package/pocketsphinx/Config.in"
source "$BR2_EXTERNAL/package/cmuclmtk/Config.in"
source "$BR2_EXTERNAL/package/python-cmuclmtk/Config.in"
source "$BR2_EXTERNAL/package/openfst/Config.in"
source "$BR2_EXTERNAL/package/phonetisaurus/Config.in"
source "$BR2_EXTERNAL/package/phonetisaurus-fst-model/Config.in"
source "$BR2_EXTERNAL/package/julius/Config.in"
source "$BR2_EXTERNAL/package/python-feedparser/Config.in"
```

## buildroot_external/configs/raspberrypi2_jasper_defconfig
```kconfig
BR2_arm=y
BR2_cortex_a7=y
BR2_ARM_FPU_NEON_VFPV4=y
BR2_PACKAGE_HOST_LINUX_HEADERS_CUSTOM_4_4=y
BR2_TOOLCHAIN_BUILDROOT_WCHAR=y
BR2_TOOLCHAIN_BUILDROOT_CXX=y
BR2_TOOLCHAIN_BUILDROOT_FORTRAN=y
BR2_TARGET_GENERIC_ROOT_PASSWD="root"
BR2_SYSTEM_DHCP="eth0"
BR2_ROOTFS_OVERLAY="$(BR2_EXTERNAL)/board/raspberrypi2/rootfs_overlay"
BR2_ROOTFS_POST_BUILD_SCRIPT="board/raspberrypi2/post-build.sh"
BR2_ROOTFS_POST_IMAGE_SCRIPT="board/raspberrypi2/post-image.sh"
BR2_LINUX_KERNEL=y
BR2_LINUX_KERNEL_CUSTOM_GIT=y
BR2_LINUX_KERNEL_CUSTOM_REPO_URL="https://github.com/raspberrypi/linux.git"
BR2_LINUX_KERNEL_CUSTOM_REPO_VERSION="26f3b72a9c049be10e6af196252283e1f6ab9d1f"
BR2_LINUX_KERNEL_DEFCONFIG="bcm2709"
BR2_LINUX_KERNEL_DTS_SUPPORT=y
BR2_LINUX_KERNEL_INTREE_DTS_NAME="bcm2709-rpi-2-b"
BR2_PACKAGE_ALSA_UTILS=y
BR2_PACKAGE_ALSA_UTILS_APLAY=y
BR2_PACKAGE_ALSA_UTILS_SPEAKER_TEST=y
BR2_PACKAGE_RPI_FIRMWARE=y
# BR2_PACKAGE_RPI_FIRMWARE_INSTALL_DTB_OVERLAYS is not set
BR2_PACKAGE_PYTHON=y
BR2_PACKAGE_PYTHON_SSL=y
BR2_PACKAGE_PYTHON_ALSAAUDIO=y
BR2_PACKAGE_PYTHON_BEAUTIFULSOUP4=y
BR2_PACKAGE_PYTHON_MAD=y
BR2_PACKAGE_PYTHON_PYTZ=y
BR2_PACKAGE_PYTHON_PYYAML=y
BR2_PACKAGE_PYTHON_REQUESTS=y
BR2_PACKAGE_PYTHON_SETUPTOOLS=y
BR2_PACKAGE_PYTHON_SHUTILWHICH=y
BR2_PACKAGE_PYTHON_SIMPLEJSON=y
BR2_PACKAGE_PYTHON_URLLIB3=y
BR2_PACKAGE_PORTAUDIO=y
BR2_PACKAGE_DROPBEAR=y
# BR2_PACKAGE_DROPBEAR_CLIENT is not set
BR2_PACKAGE_OPENSSH=y
BR2_TARGET_ROOTFS_EXT2=y
BR2_TARGET_ROOTFS_EXT2_4=y
BR2_PACKAGE_HOST_DOSFSTOOLS=y
BR2_PACKAGE_HOST_GENIMAGE=y
BR2_PACKAGE_HOST_MTOOLS=y
```

## buildroot_external/package/cmuclmtk/Config.in
```kconfig
config BR2_PACKAGE_CMUCLMTK
	bool "cmuclmtk"
	help
		Add cmuclmtk software in rootfs directory
```

## buildroot_external/package/openfst/Config.in
```kconfig
config BR2_PACKAGE_OPENFST
	bool "openfst"
	help
		Add openfst software in staging
```

## buildroot_external/package/phonetisaurus-fst-model/Config.in
```kconfig
config BR2_PACKAGE_PHONETISAURUS_FST_MODEL
	bool "phonetisaurus-fst-model"
	help
		Add phonetisaurus FST model software in rootfs directory
```

## buildroot_external/package/phonetisaurus/Config.in
```kconfig
config BR2_PACKAGE_PHONETISAURUS
	bool "phonetisaurus"
	help
		Add phonetisaurus software in rootfs directory
	depends on BR2_PACKAGE_OPENFST
```

## buildroot_external/package/pocketsphinx/Config.in
```kconfig
config BR2_PACKAGE_POCKETSPHINX
	bool "pocketsphinx"
	depends on BR2_PACKAGE_SPHINXBASE
	help
	  CMUSphinx toolkit is a leading speech recognition toolkit
	  with various tools used to build speech applications. CMU
	  Sphinx toolkit has a number of packages for different tasks
	  and applications.

	  http://cmusphinx.sourceforge.net/
	  
```

## buildroot_external/package/python-apscheduler/Config.in
```kconfig
config BR2_PACKAGE_PYTHON_APSCHEDULER
	bool "python-apscheduler"
	depends on BR2_PACKAGE_PYTHON_SETUPTOOLS_SCM
	select BR2_PACKAGE_PYTHON_SETUPTOOLS # runtime
	select BR2_PACKAGE_PYTHON_SIX # runtime
	select BR2_PACKAGE_PYTHON_PYTZ # runtime
	select BR2_PACKAGE_PYTHON_TZLOCAL # runtime
	select BR2_PACKAGE_PYTHON_FUTURES # runtime
	select BR2_PACKAGE_PYTHON_FUNCSIGS # runtime
	help
	  In-process task scheduler with Cron-like capabilities.

	  https://github.com/agronholm/apscheduler
```

## buildroot_external/package/python-cmuclmtk/Config.in
```kconfig
config BR2_PACKAGE_PYTHON_CMUCLMTK
	bool "python-cmuclmtk"
	depends on BR2_PACKAGE_CMUCLMTK

	help
	  Wrapper library for accessing the language model tools for CMU
	  Sphinx (CMUCLMTK).

	  https://github.com/Holzhaus/python-cmuclmtk
```

## buildroot_external/package/python-feedparser/Config.in
```kconfig
config BR2_PACKAGE_PYTHON_FEEDPARSER
	bool "python-feedparser"
	help
		Add feedparser python module
```

## buildroot_external/package/python-futures/Config.in
```kconfig
config BR2_PACKAGE_PYTHON_FUTURES
	bool "python-futures"
	help
	  Backport of the concurrent.futures package from Python 3.2.

	  https://github.com/agronholm/pythonfutures
```

## buildroot_external/package/python-pyaudio/Config.in
```kconfig
comment "python-pyaudio depends on Python and Portaudio"
	depends on !BR2_PACKAGE_PYTHON || !BR2_PACKAGE_PORTAUDIO
	depends on !BR2_PACKAGE_PYTHON3 || !BR2_PACKAGE_PORTAUDIO

config BR2_PACKAGE_PYTHON_PYAUDIO
	bool "python-pyaudio"
	depends on BR2_PACKAGE_PYTHON || BR2_PACKAGE_PYTHON3
	depends on BR2_PACKAGE_PORTAUDIO
	help
	  The PyAudio package
```

## buildroot_external/package/python-tzlocal/Config.in
```kconfig
config BR2_PACKAGE_PYTHON_TZLOCAL
	bool "python-tzlocal"
	select BR2_PACKAGE_PYTHON_PYTZ # runtime
	help
	  tzinfo object for the local timezone.

	  https://github.com/regebro/tzlocal
```
